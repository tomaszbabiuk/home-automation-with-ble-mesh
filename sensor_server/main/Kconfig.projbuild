## sensor_server/main/Kconfig.projbuild
```kconfig
menu "Ble-mesh sensor configuration"

    choice BLE_MESH_EXAMPLE_BOARD
        prompt "Board selection for BLE Mesh"
        default BLE_MESH_WEMOC_C3_MINI if IDF_TARGET_ESP32C3
        default BLE_MESH_WEMOS_C3_PICO if IDF_TARGET_ESP32S3
        help
            Select this option to choose the board for BLE Mesh. The default is WEMOS.CC C3 MINI


        config BLE_MESH_WEMOC_C3_MINI
            bool "Wemoc.cc C3 Mini"
            depends on IDF_TARGET_ESP32C3

        config BLE_MESH_WEMOS_C3_PICO
            bool "Wemoc.cc C3 Pico"
            depends on IDF_TARGET_ESP32C3

    endchoice

endmenu
```
